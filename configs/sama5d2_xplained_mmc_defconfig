## configs/sama5d2_xplained_mmc_defconfig
```kconfig
CONFIG_SYS_EXTRA_OPTIONS="SAMA5D2,SYS_USE_MMC"
CONFIG_ARM=y
CONFIG_TARGET_SAMA5D2_XPLAINED=y
```

## configs/sama5d2_xplained_qspiflash_defconfig
```kconfig
CONFIG_SPL=y
CONFIG_SYS_EXTRA_OPTIONS="SAMA5D2,SYS_USE_SERIALFLASH"
+S:CONFIG_ARM=y
+S:CONFIG_TARGET_SAMA5D2_XPLAINED=y
CONFIG_ATMEL_QSPI=y
```

## drivers/spi/Kconfig
```kconfig
config DM_SPI
	bool "Enable Driver Model for SPI drivers"
	depends on DM
	help
	  If you want to use driver model for SPI drivers, say Y.
	  To use legacy SPI drivers, say N.

choice
	prompt "Atmel SPI Select"
	depends on TARGET_SAMA5D2_XPLAINED
	default ATMEL_SPI

config ATMEL_SPI
	bool "Atmel Standard SPI Interface"
	help
	  If you want to use standard SPI driver, select it.

config ATMEL_QSPI
	bool "Atmel Quad SPI Interface"
	select QSPI
	help
	  If you want to use QSPI driver, select it.

endchoice

config QSPI
	bool
```
